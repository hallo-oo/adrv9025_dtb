/dts-v1/;

/include/ "zynq-zc706.dtsi"
/include/ "zynq-zc706-adv7511.dtsi"

&fpga_axi {

};

&spi0 {
	status = "okay";
};

&spi1 {
	status = "okay";
};



#include "adi-adrv9371.dtsi"

#include "peripheral.dtsi"

